## Documentation/devicetree/bindings/arm/omap/omap.txt
```
* Texas Instruments OMAP

OMAP is currently using a static file per SoC family to describe the
IPs present in the SoC.
On top of that an omap_device is created to extend the platform_device
capabilities and to allow binding with one or several hwmods.
The hwmods will contain all the information to build the device:
address range, irq lines, dma lines, interconnect, PRCM register,
clock domain, input clocks.
For the moment just point to the existing hwmod, the next step will be
to move data from hwmod to device-tree representation.


Required properties:
- compatible: Every devices present in OMAP SoC should be in the
  form: "ti,XXX"
- ti,hwmods: list of hwmod names (ascii strings), that comes from the OMAP
  HW documentation, attached to a device. Must contain at least
  one hwmod.

Optional properties:
- ti,no_idle_on_suspend: When present, it prevents the PM to idle the module
  during suspend.
- ti,no-reset-on-init: When present, the module should not be reset at init
- ti,no-idle-on-init: When present, the module should not be idled at init
- ti,no-idle: When present, the module is never allowed to idle.

Example:

spinlock@1 {
    compatible = "ti,omap4-spinlock";
    ti,hwmods = "spinlock";
};

SoC Type (optional):

- General Purpose devices
  compatible = "ti,gp"
- High Security devices
  compatible = "ti,hs"

SoC Families:

- AM33x generic
  compatible = "ti,am33xx"
- AM43x generic - defaults to AM4372
  compatible = "ti,am43"

SoCs:

- AM4372
  compatible = "ti,am4372", "ti,am43"

Boards (incomplete list of examples):


- AM437x CM-T43
  compatible = "compulab,am437x-cm-t43", "ti,am4372", "ti,am43"

- AM437x SBC-T43
  compatible = "compulab,am437x-sbc-t43", "compulab,am437x-cm-t43", "ti,am4372", "ti,am43"

- AM43x EPOS EVM
  compatible = "ti,am43x-epos-evm", "ti,am43", "ti,am438x"

- AM437x GP EVM
  compatible = "ti,am437x-gp-evm", "ti,am4372", "ti,am43"

- AM437x SK EVM: AM437x StarterKit Evaluation Module
  compatible = "ti,am437x-sk-evm", "ti,am4372", "ti,am43"
```

## Documentation/devicetree/bindings/arm/ti/omap.yaml
```yaml
# SPDX-License-Identifier: (GPL-2.0 OR BSD-2-Clause)
%YAML 1.2
---
$id: http://devicetree.org/schemas/arm/ti/omap.yaml#
$schema: http://devicetree.org/meta-schemas/core.yaml#

title: Texas Instruments OMAP SoC architecture

maintainers:
  - Tony Lindgren <tony@atomide.com>

description: Platforms based on Texas Instruments OMAP SoC architecture.

properties:
  $nodename:
    const: '/'
  compatible:
    oneOf:

      - description: TI OMAP2420 SoC based platforms
        items:
          - enum:
              - nokia,n800
              - nokia,n810
              - nokia,n810-wimax
              - ti,omap2420-h4
          - const: ti,omap2420
          - const: ti,omap2

      - description: TI OMAP2430 SoC based platforms
        items:
          - enum:
              - ti,omap2430-sdp # TI OMAP2430 SDP
          - const: ti,omap2430
          - const: ti,omap2

      - description: TI OMAP3430 SoC based platforms
        items:
          - enum:
              - compulab,omap3-cm-t3530
              - logicpd,dm3730-som-lv-devkit  # LogicPD Zoom OMAP35xx SOM-LV Development Kit
              - logicpd,dm3730-torpedo-devkit # LogicPD Zoom OMAP35xx Torpedo Development Kit
              - nokia,omap3-n900
              - openpandora,omap3-pandora-600mhz
              - ti,omap3430-sdp
              - ti,omap3-beagle
              - ti,omap3-evm                  # TI OMAP35XX EVM (TMDSEVM3530)
              - ti,omap3-ldp                  # TI OMAP3430 LDP (Zoom1 Labrador)
              - timll,omap3-devkit8000
          - const: ti,omap3430
          - const: ti,omap3

      - description: Early BeagleBoard revisions A to B4 with a timer quirk
        items:
          - const: ti,omap3-beagle-ab4
          - const: ti,omap3-beagle
          - const: ti,omap3430
          - const: ti,omap3

      - description: Gumstix Overo TI OMAP 3430/3630 boards + expansion boards
        items:
          - enum:
              - gumstix,omap3-overo-alto35
              - gumstix,omap3-overo-chestnut43
              - gumstix,omap3-overo-gallop43
              - gumstix,omap3-overo-palo35
              - gumstix,omap3-overo-palo43
              - gumstix,omap3-overo-summit
              - gumstix,omap3-overo-tobi
              - gumstix,omap3-overo-tobiduo
          - const: gumstix,omap3-overo
          - enum:
              - ti,omap3430
              - ti,omap3630

      - description: TI OMAP3630 SoC based platforms
        items:
          - enum:
              - amazon,omap3-echo             # Amazon Echo (first generation)
              - compulab,omap3-cm-t3730
              - goldelico,gta04
              - lg,omap3-sniper               # LG Optimus Black
              - logicpd,dm3730-som-lv-devkit  # LogicPD Zoom DM3730 SOM-LV Development Kit
              - logicpd,dm3730-torpedo-devkit # LogicPD Zoom DM3730 Torpedo + Wireless Development Kit
              - nokia,omap3-n9
              - nokia,omap3-n950
              - openpandora,omap3-pandora-1ghz
              - ti,omap3-beagle-xm
              - ti,omap3-evm-37xx             # TI OMAP37XX EVM (TMDSEVM3730)
              - ti,omap3-zoom3
          - const: ti,omap3630
          - const: ti,omap3

      - description: TI AM35 SoC based platforms
        items:
          - enum:
              - compulab,omap3-sbc-t3517 # CompuLab SBC-T3517 with CM-T3517
              - teejet,mt_ventoux
              - ti,am3517-craneboard     # TI AM3517 CraneBoard (TMDSEVM3517)
              - ti,am3517-evm            # TI AM3517 EVM (AM3517/05 TMDSEVM3517)
          - const: ti,am3517
          - const: ti,omap3

      - description: TI AM33 based platform
        items:
          - enum:
              - compulab,cm-t335
              - moxa,uc-8100-me-t
              - novatech,am335x-lxm
              - seeed,am335x-bone-green-eco
              - ti,am335x-bone
              - ti,am335x-evm
              - ti,am3359-icev2
          - const: ti,am33xx

      - description: Compulab board variants based on TI AM33
        items:
          - enum:
              - compulab,sbc-t335
          - const: compulab,cm-t335
          - const: ti,am33xx

      - description: Phytec boards based on TI AM33
        items:
          - enum:
              - phytec,am335x-wega
              - phytec,am335x-pcm-953
              - phytec,am335x-regor
          - const: phytec,am335x-phycore-som
          - const: ti,am33xx

      - description: TI OMAP4430 SoC based platforms
        items:
          - enum:
              - amazon,omap4-kc1        # Amazon Kindle Fire (first generation)
              - motorola,droid4         # Motorola Droid 4 XT894
              - motorola,droid-bionic   # Motorola Droid Bionic XT875
              - motorola,xyboard-mz609
              - motorola,xyboard-mz617
              - ti,omap4-panda
              - ti,omap4-sdp
          - const: ti,omap4430
          - const: ti,omap4

      - description: OMAP4 PandaBoard Revision A4 and later
        items:
          - const: ti,omap4-panda-a4
          - const: ti,omap4-panda
          - const: ti,omap4430
          - const: ti,omap4

      - description: OMAP4 DuoVero with Parlor expansion board/daughter board
        items:
          - const: gumstix,omap4-duovero-parlor
          - const: gumstix,omap4-duovero
          - const: ti,omap4430
          - const: ti,omap4

      - description: TI OMAP4460 SoC based platforms
        items:
          - enum:
              - epson,embt2ws    # Epson Moverio BT-200
              - ti,omap4-panda-es
          - const: ti,omap4460
          - const: ti,omap4

      - description: VAR-OM44 boards
        items:
          - enum:
              - variscite,var-dvk-om44
              - variscite,var-stk-om44
          - const: variscite,var-som-om44
          - const: ti,omap4460
          - const: ti,omap4

      - description: TI OMAP5 SoC based platforms
        items:
          - enum:
              - compulab,omap5-cm-t54
              - isee,omap5-igep0050
              - ti,omap5-uevm
          - const: ti,omap5

      - description: TI DRA762 SoC based platforms
        items:
          - enum:
              - ti,dra76-evm  # Software Development Board for DRA762
          - const: ti,dra762
          - const: ti,dra7

      - description: TI DRA742 SoC based platforms
        items:
          - enum:
              - ti,dra7-evm   # Software Development Board for DRA742
          - const: ti,dra742
          - const: ti,dra74
          - const: ti,dra7

      - description: TI DRA722 SoC based platforms
        items:
          - enum:
              - ti,dra72-evm  # Software Development Board for DRA722
          - const: ti,dra722
          - const: ti,dra72
          - const: ti,dra7

      - description: TI DRA718 SoC based platforms
        items:
          - enum:
              - ti,dra718-evm # Software Development Board for DRA718
          - const: ti,dra718
          - const: ti,dra722
          - const: ti,dra72
          - const: ti,dra7

      - description: TI AM5748 SoC based platforms
        items:
          - enum:
              - ti,am5748-idk  # AM5748 IDK
          - const: ti,am5748
          - const: ti,dra762
          - const: ti,dra7

      - description: TI AM5728 SoC based platforms
        items:
          - enum:
              - ti,am5728-idk  # AM5728 IDK
          - const: ti,am5728
          - const: ti,dra742
          - const: ti,dra74
          - const: ti,dra7

      - description: TI AM5726 SoC based platforms
        items:
          - const: ti,am5726
          - const: ti,dra742
          - const: ti,dra74
          - const: ti,dra7

      - description: TI AM5718 SoC based platforms
        items:
          - enum:
              - ti,am5718-idk  # AM5718 IDK
          - const: ti,am5718
          - const: ti,dra722
          - const: ti,dra72
          - const: ti,dra7

      - description: TI AM5716 SoC based platforms
        items:
          - const: ti,am5716
          - const: ti,dra722
          - const: ti,dra72
          - const: ti,dra7

      # CompuLab AM57xx boards
      - description: CompuLab CL-SOM-AM57x boards
        items:
          - enum:
              - compulab,sbc-am57x  # AM57XX SBC-AM57x
          - const: compulab,cl-som-am57x
          - const: ti,am5728
          - const: ti,dra742
          - const: ti,dra74
          - const: ti,dra7

      - description: CompuLab CL-SOM-AM57x SoM
        items:
          - const: compulab,cl-som-am57x
          - const: ti,am5728
          - const: ti,dra742
          - const: ti,dra74
          - const: ti,dra7

      # PHYTEC AM57xx boards
      - description: PHYTEC AM57x phyCORE RDK
        items:
          - enum:
              - phytec,am57xx-pcm-948  # AM57XX PHYTEC PCM-948
          - const: phytec,am57xx-phycore-som
          - const: ti,dra7

      - description: PHYTEC AM572x phyCORE SoM
        items:
          - const: phytec,am572x-phycore-som
          - const: ti,am5728
          - const: ti,dra74
          - const: ti,dra7

additionalProperties: true

...
```
