// SPDX-License-Identifier: (GPL-2.0+ OR MIT)
/*
 * Copyright (C) 2025 PHYTEC Messtechnik GmbH
 * Author: Primoz Fiser <primoz.fiser@norik.com>
 */

/dts-v1/;

#include "am572x-phycore-som.dtsi"
#include "am57xx-pcm-948.dtsi"
